## legacy/lms-master/cmds/cmds-services/conf/local.conf
```bitbake
include "commons.local.conf"

http.port=19014
jvm.memory="-Xms64M -Xmx128M"

symbol.file="conf/resources/symbol_map.txt"

#Learnpedia Organization Id
#~~~~~~~~~~~~~~~~~~~~~~~
learnpedia.id="584e44e8c92e5dca741bae2a"
```

## legacy/lms-master/comm/comm-services/conf/local.conf
```bitbake
include "commons.local.conf"

http.port=19017
jvm.memory="-Xms64M -Xmx128M"

vedantu.newsfeed.lookbackdays=50

newsfeeds.default.count=10
activityfeeds.default.count=10
notifications.default.count=10
```

## legacy/lms-master/event/event-bus-mgmt/conf/local.conf
```bitbake
include "commons.local.conf"
http.port=19015
jvm.memory="-Xms64M -Xmx512M"

#default wait time before produce a event to consume
reproduce.wait.time=50000

#producer maxt tries 
max.tries=3

#challenge configurations
challenge.leaderboard.min.attempt=1


#[TASK-CONFIG
#task batchSize for event threadManager
task.batch.size="EXPORT:2;CALCULATE_SIZE:10"

#task number of threads for event threadManager
task.thread.number="EXPORT:2;CALCULATE_SIZE:10"

#sleep time for thread for task threadManager
task.sleep.time="EXPORT:10000;CALCULATE_SIZE:5000"

#Vedantu website
infographic.link = "http://localhost:19005"
```

## legacy/lms-master/organization/organization-services/conf/local.conf
```bitbake
include "commons.local.conf"

http.port=19012
jvm.memory="-Xms64M -Xmx128M"

#REFERRAL CAMPAIGN CONFIG
#~~~~~~~~~~~~~~~~~~~~~~~~
campaign.referral=""
campaign.section.id=""
campaign.center.id=""
campaign.program.id=""
campaign.agent.packagedays="30"
campaign.user.packagedays="14"

#SMS COUNTRY CONFIG
#~~~~~~~~~~~~~~~~~~~~~~~
smscountry.url="http://api.smscountry.com/SMSCwebservice_bulk.aspx"
smscountry.user="learnpedia"
smscountry.passwd="__REDACTED__"
smscountry.sid="LPEDIA"
smscountry.mtype="N"
smscountry.dr="Y"
otp.size=4

#Learnpedia Organisation Id
#~~~~~~~~~~~~~~~~~~~~~~~~
learnpedia.id="5874a52bc92ed65e3defc7e5"

#Programs Bucket Name
#~~~~~~~~~~~~~~~~~~~~~~
bucket.name="program-qa-learnpediaqa"

#Auto Add Demo Programs
#~~~~~~~~~~~~~~~~~~~~~~~
jeedemo.section.id="58e1e84ba444bd84e57a413a"
jeedemo.center.id="5874a6bbc92ed65e3defc7f9"
jeedemo.program.id="58e1e7efa444bd84e57a412f"

neetdemo.section.id="58db4a48c92ee3ccaf057953"
neetdemo.center.id="5874a6bbc92ed65e3defc7f9"
neetdemo.program.id="58db4a0ac92ee3ccaf057950"

#Leadsquared Campaign Programs
#~~~~~~~~~~~~~~~~~~~~~~~
emp.section.id="59550c82e4b066936712ea5e"
emp.center.id="56936df744aed64166ee09db"
emp.program.id="570f38e144ae7d512b34447d"

jeesoln.section.id="59550ca9e4b066936712ea61"
jeesoln.center.id="56936df744aed64166ee09db"
jeesoln.program.id="570f38e144ae7d512b34447d"

neetseries.section.id="59550cbae4b066936712ea64"
neetseries.center.id="56936df744aed64166ee09db"
neetseries.program.id="570f38e144ae7d512b34447d"

#Programs custom description
#~~~~~~~~~~~~~~~~~~~~~~~

"58e1e84ba444bd84e57a413a.desc"="SCORE (Simple and Complete Online Resource) is a digital learning platform for various competitive exams"
"58e1e84ba444bd84e57a413a.firstPoint"="Videos - 4000+"
"58e1e84ba444bd84e57a413a.secondPoint"="Practice Content - 20000+"
"58e1e84ba444bd84e57a413a.thirdPoint"="Practice Mock Tests - 1800+"
"58e1e84ba444bd84e57a413a.fourthPoint"="Doubts Forum"
"58e1e84ba444bd84e57a413a.imageUrl"="/public/images/programImages/scorejee_online.jpg"

"58db4a48c92ee3ccaf057953.desc"="SCORE (Simple and Complete Online Resource) is a digital learning platform for various competitive exams"
"58db4a48c92ee3ccaf057953.firstPoint"="Videos - 4000+"
"58db4a48c92ee3ccaf057953.secondPoint"="Practice Content - 20000+"
"58db4a48c92ee3ccaf057953.thirdPoint"="Practice Mock Tests - 1800+"
"58db4a48c92ee3ccaf057953.fourthPoint"="Doubts Forum"
"58db4a48c92ee3ccaf057953.imageUrl"="/public/images/programImages/scoreneet_online.jpg"

"5874a700c92ed65e3defc7fd.desc"="SCORE (Simple and Complete Online Resource) is a digital learning platform for various competitive exams"
"5874a700c92ed65e3defc7fd.firstPoint"="Videos - 4000+"
"5874a700c92ed65e3defc7fd.secondPoint"="Practice Content - 20000+"
"5874a700c92ed65e3defc7fd.thirdPoint"="Practice Mock Tests - 1800+"
"5874a700c92ed65e3defc7fd.fourthPoint"="Doubts Forum"
"5874a700c92ed65e3defc7fd.imageUrl"="/public/images/programImages/scorejee_sdcard.jpg"

"5874a749c92ed65e3defc801.desc"="SCORE (Simple and Complete Online Resource) is a digital learning platform for various competitive exams"
"5874a749c92ed65e3defc801.firstPoint"="Videos - 4000+"
"5874a749c92ed65e3defc801.secondPoint"="Practice Content - 20000+"
"5874a749c92ed65e3defc801.thirdPoint"="Practice Mock Tests - 1800+"
"5874a749c92ed65e3defc801.fourthPoint"="Doubts Forum"
"5874a749c92ed65e3defc801.imageUrl"="/public/images/programImages/scoreneet_sdcard.jpg"


#InstaMojo key credentails
#~~~~~~~~~~~~~~~~~~~~~~~
instamojo.env = "test"
instamojo.url = "https://test.instamojo.com/oauth2/token/"
instamojo.clientid = "test_jow34m9BKuNnhHcS2wJQ87W16cZBnRUf5hc"
instamojo.clientsecretkey = "__REDACTED__"
```

## lms-master/billing/billing-services/conf/local.conf
```bitbake
include "commons.local.conf"

http.port=19022
jvm.memory="-Xms64M -Xmx128M"

payment.page.url="http://localhost:19022/paymentGateway.html"
payment.defaultChannel="INSTAMOJO"

ccavenue.charging.url="https://secure.ccavenue.com/transaction/transaction.do"
ccavenue.merchant_id="96494"
ccavenue.access_code="AVYQ64DD92BL85QYLB"
ccavenue.enc_key="6975C53ED38230FE408B5EA7F4507FAE"
ccavenue.redirect_url="http://localhost:19022/payments/onPaymentReceived"

ebs.charging.url="https://secure.ebs.in/pg/ma/sale/pay/"
ebs.accountId="5880"
ebs.secretKey="__REDACTED__"
ebs.redirect_url="http://localhost:19022/payments/onPaymentReceivedEBS?DR={DR}"
ebs.mode="TEST"
ebs.pageId=""
ebs.securehash.algorithm="MD5"

instamojo.charging.url="https://test.instamojo.com/api/1.1/payment-requests/"
instamojo.apikey="__REDACTED__"
instamojo.authtoken="test_bf24b6355b88f4a5854eb7178fb"

targetPMT.orgId="56efa5bf44ae7b400f937ca2"
targetPMT.paymentChannel="CCAvenue"
```
